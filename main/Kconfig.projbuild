## main/Kconfig.projbuild
```kconfig
menu "Button Configuration"

    config DEBOUNCE_MS
        int "Debounce time in ms"
        range 5 200
        default 20
        help
            Debounce time in milliseconds for the button (GPIO 41).

endmenu
```
